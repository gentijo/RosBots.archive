## microros_ws/assemblies/esp32-range-buggy/main/Kconfig.projbuild
```kconfig
menu "Microbot App ROS Settings"

    config MICRO_ROS_APP_STACK
        int "Stack the micro-ROS app (Bytes)"
        default 16000
        help
        Stack size in Bytes of the micro-ROS app

    config MICRO_ROS_APP_TASK_PRIO
        int "Priority of the micro-ROS app"
        default 5
        help
        Priority of micro-ros task higher value means higher priority

endmenu

menu "Maqueen Bot"

    menu "I2C Host"
        config I2C_HOST_SCL
            int "SCL GPIO Num"
            default 6 if IDF_TARGET_ESP32C3
            default 19 if IDF_TARGET_ESP32 || IDF_TARGET_ESP32S2 || IDF_TARGET_ESP32S3
            help
                GPIO number for I2C Master clock line.

        config I2C_HOST_SDA
            int "SDA GPIO Num"
            default 5 if IDF_TARGET_ESP32C3
            default 18 if IDF_TARGET_ESP32 || IDF_TARGET_ESP32S2 || IDF_TARGET_ESP32S3
            help
                GPIO number for I2C Master data line.

        config I2C_HOST_PORT_NUM
            int "Port Number"
            default 1 if IDF_TARGET_ESP32 || IDF_TARGET_ESP32S2 || IDF_TARGET_ESP32S3
            default 0 if IDF_TARGET_ESP32C3
            help
                Port number for I2C Master device.

        config I2C_HOST_FREQUENCY
            int "Host Frequency"
            default 100000
            help
                I2C Speed of Host device.
    endmenu

    menu "I2C Device"
        config I2C_DEVICE_SCL
            int "SCL GPIO Num"
            default 5
            help
                GPIO number for I2C Device clock line.

        config I2C_DEVICE_SDA
            int "SDA GPIO Num"
            default 4
            help
                GPIO number for I2C Device data line.

        config I2C_DEVICE_PORT_NUM
            int "Port Number"
            default 0
            help
                Port number for I2C device.

        config I2C_DEVICE_ADDRESS
            hex "ESP Device Address"
            default 0x28
            help
                Hardware Address of I2C Device Port.
    endmenu


endmenu
```
